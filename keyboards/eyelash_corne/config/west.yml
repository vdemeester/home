## keyboards/eyelash_corne/config/west.yml
```yaml
manifest:
  remotes:
    - name: zmkfirmware
      url-base: https://github.com/zmkfirmware
      # url-base: https://github.com/darknao
      # revision: rgb-layer-25.04
      # Additional modules containing boards/shields/custom code can be listed here as well.
      # See:
      # - https://zmk.dev/docs/features/modules
      # - https://docs.zephyrproject.org/3.5.0/develop/west/manifest.html#projects
    - name: urob
      url-base: https://github.com/urob
    - name: m165437 #new entry
      url-base: https://github.com/M165437 #new entry
  projects:
    - name: eyelash_corne
      url: https://github.com/a741725193/zmk-new_corne
      revision: main
    - name: zmk
      remote: zmkfirmware
      revision: main
      # revision: rgb-layer-25.04
      import: app/west.yml
    - name: zmk-helpers
      remote: urob
      revision: main
    - name: nice-view-gem #new entry
      remote: m165437 #new entry
      revision: main #new entry
  self:
    path: config
```
