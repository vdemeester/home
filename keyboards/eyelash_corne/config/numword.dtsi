// Numword behavior - smart number layer
// Based on https://github.com/urob/zmk-auto-layer

/ {
    behaviors {
        num_word: num_word {
            compatible = "zmk,behavior-auto-layer";
            #binding-cells = <1>;
            continue-list = <BACKSPACE DELETE DOT COMMA PLUS MINUS STAR FSLH EQUAL>;
            ignore-numbers;
        };
    };
};

/*
Local Variables:
mode: c
End:
*/
